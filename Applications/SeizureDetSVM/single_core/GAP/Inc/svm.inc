PI_L2
static const int SVM_SIZE = 74;

PI_L2
int32_t meanFeat[NUM_FEATURES] = {
  6531857,
  792732,
  744598,
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  87963,
};

PI_L2
int32_t scaleFeat[NUM_FEATURES] = {
  7517820,
  16379580,
  11878958,
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  17529482,
};

PI_L2
int32_t bias = 2285451;

PI_L2
int32_t alpha[SVM_SIZE] = {
  -1123042,
  -7908369,
  -1723851,
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  2526187,
};

PI_L2
int32_t svmVect[SVM_SIZE][NUM_FEATURES] = {
  {879126, -827981, -714491, -645730, -406587, -274039, -633533, -231509, -713854, -822017, -822017, -713854, -52957, -350317, -759807, -658204, -738340, -939449, -529497, -256842, -604198, 259502, 826999, -376825, 2594211, -805793, -1111969, 1489112, -486472, -917462, 141172, -621504, -1039558, -798780, -428507, 1514018, -823317, -22725, 918519, 380298, 3190406, 161791, -921329, 1143174, -1986431, 2624687, -1532196, 324480, -104052, 1658503, -2057826, 181412, 687774},
  {755377, -953625, -712772, -485835, -405161, 1871859, -654253, 959296, -711438, -975973, -975973, -711446, -278384, -457213, -892640, -711178, -598410, 475752, -476783, 392679, 794628, 178552, 110595, -459713, 978380, 309481, -1301107, 1633447, -144737, -1875047, -221191, -284214, -882599, -721898, -858608, 1768688, -857324, 832334, -187200, 61430, 2525005, 2285644, -715498, -403517, 677649, 484526, -1001046, -175876, -350828, 202400, 671122, -533658, -76739},
  {808435, -948827, -691716, -305127, -405791, 1849596, -558161, 816967, -690408, -978288, -978279, -690408, -339286, -471121, -853088, -723366, -871249, -896918, -342918, 437223, 259510, -809006, 496346, -1158500, 275977, 236458, 1637255, 2442821, -596279, -712570, 571642, 513811, 265139, -1380304, 1525561, 1424897, 1416450, -128614, -545234, -365861, 1606477, 392797, -794896, -618735, 12273, -918670, 857249, 1240281, -1788242, 849741, 28496, -1290864, 1592124},
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  {-1099596, 1322347, 1392719, 1112397, 6054528, 86671, -220151, -269945, 1388357, 1316449, 1316449, 1388365, -683797, -128774, 1494884, 2882544, 2370218, 1975500, 335234, -1039424, -852954, -917890, -822394, -1308195, -1015282, -520203, -1540635, -607696, -1035481, 864287, -502452, -1128184, -1010425, -99061, -166162, -999142, -1166268, -1406694, -1093254, -928392, -1236951, -1053802, 216904, -692807, -428733, 158570, 417744, -168024, -152169, -297737, 1376101, -1105518, 364888},
};

